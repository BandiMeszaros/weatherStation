## main/Kconfig.projbuild
```kconfig
menu "Weather Station Configuration"

    config SENSOR_I2C_SDA
        int "SDA GPIO Number"
        default 22
        help
            GPIO number to use for the I2C SDA line.

    config SENSOR_I2C_SCL
        int "SCL GPIO Number"
        default 23
        help
            GPIO number to use for the I2C SCL line.

    config MEASUREMENT_INTERVAL_MS
        int "Measurement Interval (ms)"
        default 20000
        range 500 6000000
        help
            How often to read from the GXHT30 sensor.

    config WIFI_SSID
        string "WiFi SSID"
        default "YOUR_WIFI_SSID"
        help
            The SSID of the WiFi network to connect to.

    config WIFI_PASSWORD
        string "WiFi Password"
        default "YOUR_WIFI_PASSWORD"
        help
            The password of the WiFi network to connect to.
    
    config MQTT_BROKER_IP
        string "MQTT Broker IP"
        default "192.168.1.173"
        help
            The IP of the MQTT broker to publish weather data to.

endmenu
```
